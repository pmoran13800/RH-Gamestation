## package/batocera/boot/batocera-x86_64_efi/Config.in
```kconfig
config BR2_PACKAGE_BATOCERA_X86_64_EFI
    bool "rhgamestation-x86_64_efi"
    help
      EFI 64 bit precompiled

      https://github.com/pmoran13800/rhgamestation-x86_64_efi
```

## package/batocera/emulationstation/recalbox-themes/Config.in
```kconfig
config BR2_PACKAGE_RECALBOX_THEMES
        bool "recalbox ES themes"
        help
          Emulationstation themes for recalbox.

	  https://github.com/pmoran13800/rhgamestation-themes
```
